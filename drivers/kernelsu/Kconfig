## drivers/kernelsu/Kconfig
```kconfig
menu "KernelSU"

config KSU
	tristate "KernelSU function support"
	help
	  Enable kernel-level root privileges on Android System.
	  To compile as a module, choose M here: the
	  module will be called kernelsu.

config KSU_DEBUG
	bool "KernelSU debug mode"
	depends on KSU
	default n
	help
	  Enable KernelSU debug mode.

config KSU_ALLOWLIST_WORKAROUND
	bool "KernelSU Session init keyring workaround"
	depends on KSU
	default n
	help
	  Enable session keyring init workaround for problematic devices.
	  Useful for situations where the SU allowlist is not kept after a reboot.

config KSU_MANUAL_HOOK
	bool "Manual hooking GKI kernels without kprobes"
	depends on KSU && KSU != m
	default y if !KPROBES
	default n
	help
	  If enabled, Hook required KernelSU syscalls with manually-patched function.
	  If disabled, Hook required KernelSU syscalls with Kernel-probe.

endmenu
```
